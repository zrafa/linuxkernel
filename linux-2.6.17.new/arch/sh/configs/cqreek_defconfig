## linux-2.6.17.new/sound/sh/Kconfig
```kconfig
menu "SuperH devices"
       depends on SND!=n && SUPERH

config SND_AICA
       tristate "Yamaha AICA sound for SEGA Dreamcast"
       depends on SND
       depends on SH_DREAMCAST
       select SND_PCM
       help
         Say Y here to include support for sound on your SEGA Dreamcast

         To compile this driver as a module, choose M here: the module
         will be called snd-aica.

config SND_SH_DAC_AUDIO
	tristate "SuperH DAC audio support"
	depends on SND
	depends on CPU_SH3
	select SND_PCM

endmenu
```
